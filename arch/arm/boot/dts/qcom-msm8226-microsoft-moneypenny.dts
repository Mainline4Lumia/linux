// SPDX-License-Identifier: BSD-3-Clause
/*
 * Copyright (c) 2022, Jack Matthews <jm5112356@gmail.com>
 * Copyright (c) 2022, Ivaylo Ivanov <ivo.ivanov.ivanov1@gmail.com>
 * Copyright (c) 2022, Dominik Kobinski <dominikkobinski314@gmail.com>
 * Copyright (c) 2022, Rayyan Ansari <rayyan@ansari.sh>
 */

/dts-v1/;

#include "qcom-msm8226-microsoft-common.dtsi"

/ {
	model = "Nokia Lumia 630";
	compatible = "microsoft,moneypenny", "qcom,msm8226";
	chassis-type = "handset";
};

&framebuffer0 {
	width = <480>;
	height = <854>;
	stride = <(480 * 4)>;
};
