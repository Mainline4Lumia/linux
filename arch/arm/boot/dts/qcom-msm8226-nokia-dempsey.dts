// SPDX-License-Identifier: BSD-3-Clause
/*
 * Copyright (c) 2022, Jack Matthews <jm5112356@gmail.com>
 * Copyright (c) 2022, Ivaylo Ivanov <ivo.ivanov.ivanov1@gmail.com>
 * Copyright (c) 2022, Dominik Kobinski <dominikkobinski314@gmail.com>
 * Copyright (c) 2022, Rayyan Ansari <rayyan@ansari.sh>
 */

/dts-v1/;

#include "qcom-msm8226-nokia-common.dtsi"

/ {
	model = "Microsoft Lumia 640";
	compatible = "nokia,dempsey", "qcom,msm8226";
	chassis-type = "handset";
};

&blsp1_i2c3 {
	status = "okay";

	nfc@28 {
		compatible = "nxp,nxp-nci-i2c";
		reg = <0x28>;

		interrupt-parent = <&tlmm>;
		interrupts = <21 IRQ_TYPE_LEVEL_HIGH>;

		enable-gpios = <&tlmm 20 GPIO_ACTIVE_HIGH>;
		firmware-gpios = <&tlmm 22 GPIO_ACTIVE_HIGH>;
	};
};
